// Enable the i2s interface
/dts-v1/;
/plugin/;

/ {
    compatible = "brcm,bcm2835";

	fragment@0 {
		target = < 0xdeadbeef >;

		__overlay__ {
			#address-cells = < 0x01 >;
			#size-cells = < 0x00 >;

			mcp23017@26 {
				compatible = "microchip,mcp23017";
				reg = < 0x26 >;
				gpio-controller;
				#gpio-cells = < 0x02 >;
				interrupt-parent = < 0xdeadbeef >;
				interrupts = < 24 0x02 >;
				interrupt-controller;
				#interrupt-cells = < 0x02 >;
				microchip,irq-mirror;
				status = "okay";
			};
		};
	};


    fiq: cfa10049_fiq {
        compatible = "iets";
	pinctrl-names = "default";
   	pinctrl-0 = <&fiq_pins_cfa10049>;
	interrupts = <50>;
	clocks = <&clks 26>;
	memory-region = <&fiq_mem>;
	crystalfontz,fiq-gpios = <
			       &gpio0 0 0  /* STEP_X */
			       &gpio0 5 0  /* DIR_Z */
			       >;
	};
};
